## config/boards/shields/eyeslash_corne/Kconfig.defconfig
```kconfig
if SHIELD_EYESLASH_CORNE_CENTRAL_DONGLE

config ZMK_KEYBOARD_NAME
    default "Corne_Dongle"

config ZMK_SPLIT_ROLE_CENTRAL
    default y

endif


if SHIELD_EYESLASH_CORNE_CENTRAL_DONGLE || SHIELD_EYESLASH_CORNE_PERIPHERAL_LEFT || SHIELD_EYESLASH_CORNE_PERIPHERAL_RIGHT

config ZMK_SPLIT
    default y

config ZMK_HID_INDICATORS
    default y

config ZMK_SPLIT_PERIPHERAL_HID_INDICATORS
    default y

config EYESLASH_CORNE_CAPS_LOCK_LED
    bool "Use one RGB LED as a caps lock indicator"
    default y if SHIELD_EYESLASH_CORNE_PERIPHERAL_LEFT
    depends on ZMK_RGB_UNDERGLOW && ZMK_HID_INDICATORS

config EYESLASH_CORNE_CAPS_LOCK_LED_INDEX
    int "Caps lock indicator LED index"
    default 2
    depends on EYESLASH_CORNE_CAPS_LOCK_LED

config EYESLASH_CORNE_CAPS_LOCK_LED_BRIGHTNESS
    int "Caps lock indicator red brightness"
    default 96
    depends on EYESLASH_CORNE_CAPS_LOCK_LED


if ZMK_DISPLAY

config I2C
    default y

config SSD1306
    default y

choice ZMK_DISPLAY_WORK_QUEUE
    default ZMK_DISPLAY_WORK_QUEUE_DEDICATED
endchoice

endif

if SSD1306

config LV_Z_VDB_SIZE
    default 64

config LV_DPI_DEF
    default 148

config LV_Z_BITS_PER_PIXEL
    default 1

choice LV_COLOR_DEPTH
    default LV_COLOR_DEPTH_1
endchoice

endif

if ZMK_BACKLIGHT

config PWM
    default y

config LED_PWM
    default y

endif # ZMK_BACKLIGHT

endif
```
